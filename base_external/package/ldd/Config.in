## base_external/package/ldd/Config.in
```kconfig
config BR2_PACKAGE_LDD
	bool "ldd"
	help
	  Includes the scull load, unload as well as module load,unload in the kernel image.
	  Used to understand buildroot external trees and package builds.
```
